/dts-v1/;
/plugin/;

/*
** Device Tree Overlay for eQ-3 HM-MOD-RPI-PCB
** for the HomeAssistant Yellow
**
** Copyright (c) 2023 Jens Maus <mail@jens-maus.de>
** Licensed under Apache 2.0
**
*/

/ {
    compatible = "brcm,bcm2708";

    // fragment to define uart/serial dependencies for
    // generic_raw_uart
    fragment@0 {
        target = <&uart0>;
        __overlay__ {
            compatible = "pivccu,pl011";
            status = "okay";
            pivccu,reset-gpios = <&gpio 18 0>; // HM-MOD-RPI-PCB
        };
    };

    // fragment to make sure that stdout-path under chosen
    // is empty so that the above uart0 fragment does not
    // interfere with u-boot trying to access serial drivers.
    fragment@1 {
        target = <&chosen>;
        __overlay__ {
            stdout-path = "";
        };
    };
};
