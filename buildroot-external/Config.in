## buildroot-external/package/licenseinfo/Config.in
```kconfig
config BR2_PACKAGE_LICENSEINFO
	bool "License info html"
	help
	  Integrate licenses.html into image at /www/rega/licenseinfo.htm
```

## buildroot-external/package/multilib32/Config.in
```kconfig
config BR2_PACKAGE_MULTILIB32
	bool "multilib32"
	help
	  On 64-bit systems, this virtual package enables 32-bit
	  multilib support. The created 32-bit libraries are stored
	  under /lib32 and /usr/lib32 so that both 64-bit and
	  32-bit binaries can be executed.

config BR2_PACKAGE_MULTILIB32_CONFIG_FRAGMENT_FILE
	string "kconfig fragment file"
	depends on BR2_PACKAGE_MULTILIB32
```

## buildroot-external/package/recovery-system/Config.in
```kconfig
config BR2_PACKAGE_RECOVERY_SYSTEM
	bool "recovery-system"
	help
	  Creates a dedicated recovery system and provides it
	  as an initrd.

config BR2_PACKAGE_RECOVERY_SYSTEM_CONFIG_FRAGMENT_FILE
	string "kconfig fragment file"
	depends on BR2_PACKAGE_RECOVERY_SYSTEM
```

## buildroot-external/package/recovery-system/external/Config.in
```kconfig
source "$BR2_EXTERNAL_RECOVERY_SYSTEM_PATH/../../../package/multilib32/Config.in"

menu "Kernel Module Support"
  source "$BR2_EXTERNAL_RECOVERY_SYSTEM_PATH/../../../package/generic_raw_uart/Config.in"
endmenu

menu "Software Support"
  source "$BR2_EXTERNAL_RECOVERY_SYSTEM_PATH/package/hm-platform/Config.in"
  source "$BR2_EXTERNAL_RECOVERY_SYSTEM_PATH/../../../package/detect_radio_module/Config.in"
  source "$BR2_EXTERNAL_RECOVERY_SYSTEM_PATH/../../../package/wiringpi-rpi/Config.in"
  source "$BR2_EXTERNAL_RECOVERY_SYSTEM_PATH/../../../package/qemu-guest-agent/Config.in"
endmenu

# External packages
source "$BR2_EXTERNAL_RECOVERY_SYSTEM_PATH/Config.ext.in"
```

## buildroot-external/package/rpi-eeprom/Config.in
```kconfig
config BR2_PACKAGE_RPI_EEPROM
	bool "rpi-eeprom"
	help
	  EEPROM bootloader firmware for Raspberry Pi 4 and Pi 5

	  https://github.com/raspberrypi/rpi-eeprom

if BR2_PACKAGE_RPI_EEPROM

choice
	prompt "For Target"
	default BR2_PACKAGE_RPI_EEPROM_RPI4

config BR2_PACKAGE_RPI_EEPROM_RPI4
	bool "Raspberry Pi 4"
	help
	  For the Raspberry Pi 4

config BR2_PACKAGE_RPI_EEPROM_RPI5
	bool "Raspberry Pi 5"
	help
	  For the Raspberry Pi 5

endchoice

endif
```

## buildroot-external/package/rpi-userland/Config.in
```kconfig
config BR2_PACKAGE_RPI_USERLAND
	bool "rpi-userland"
	depends on BR2_arm || BR2_aarch64
	depends on BR2_TOOLCHAIN_USES_GLIBC
	depends on BR2_INSTALL_LIBSTDCPP
	help
	  Raspberry Pi VideoCore userland utility package used by OpenCCU
	  to provide vcgencmd (VideoCore general command tool).

	  https://github.com/raspberrypi/userland

comment "rpi-userland needs a glibc toolchain w/ C++"
	depends on BR2_arm || BR2_aarch64
	depends on !BR2_TOOLCHAIN_USES_GLIBC || !BR2_INSTALL_LIBSTDCPP
```

## buildroot-external/package/tailscale-bin/Config.in
```kconfig
config BR2_PACKAGE_TAILSCALE_BIN
	bool "Tailscale (Zero config wireguard-based VPN)"
	help
	  Tailscale Zero config wireguard-based VPN

	  https://tailscale.com/
```

## buildroot-external/package/vcgencmd/Config.in
```kconfig
config BR2_PACKAGE_VCGENCMD
	bool "vcgencmd"
	depends on BR2_arm || BR2_aarch64
	depends on BR2_TOOLCHAIN_USES_GLIBC
	depends on BR2_INSTALL_LIBSTDCPP
	help
	  Raspberry Pi VideoCore userland utility used by
	  OpenCCU to provide vcgencmd (VideoCore command tool).

	  https://github.com/raspberrypi/userland

comment "vcgencmd needs a glibc toolchain w/ C++"
	depends on BR2_arm || BR2_aarch64
	depends on !BR2_TOOLCHAIN_USES_GLIBC || !BR2_INSTALL_LIBSTDCPP
```
