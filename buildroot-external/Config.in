## buildroot-external/Config.in
```kconfig
source "$BR2_EXTERNAL_EQ3_PATH/package/multilib32/Config.in"
source "$BR2_EXTERNAL_EQ3_PATH/package/recovery-system/Config.in"

menu "eQ-3 HomeMatic Services"
  source "$BR2_EXTERNAL_EQ3_PATH/package/occu/Config.in"
  source "$BR2_EXTERNAL_EQ3_PATH/package/cloudmatic/Config.in"
  source "$BR2_EXTERNAL_EQ3_PATH/package/hmlangw/Config.in"
  source "$BR2_EXTERNAL_EQ3_PATH/package/libxmlparser/Config.in"
  source "$BR2_EXTERNAL_EQ3_PATH/package/libxmlrpcxx/Config.in"
  source "$BR2_EXTERNAL_EQ3_PATH/package/tclrpc/Config.in"
  source "$BR2_EXTERNAL_EQ3_PATH/package/tclrega/Config.in"
endmenu

menu "Kernel Module Support"
  source "$BR2_EXTERNAL_EQ3_PATH/package/generic_raw_uart/Config.in"
  source "$BR2_EXTERNAL_EQ3_PATH/package/bcm2835_raw_uart/Config.in"
  source "$BR2_EXTERNAL_EQ3_PATH/package/eq3_char_loop/Config.in"
endmenu

menu "Hardware Support"
  source "$BR2_EXTERNAL_EQ3_PATH/package/rpi-rf-mod/Config.in"
  source "$BR2_EXTERNAL_EQ3_PATH/package/susvd/Config.in"
  source "$BR2_EXTERNAL_EQ3_PATH/package/piusvd/Config.in"
  source "$BR2_EXTERNAL_EQ3_PATH/package/picod/Config.in"
  source "$BR2_EXTERNAL_EQ3_PATH/package/strompi2d/Config.in"
  source "$BR2_EXTERNAL_EQ3_PATH/package/pidesktopd/Config.in"
  source "$BR2_EXTERNAL_EQ3_PATH/package/argononed/Config.in"
  source "$BR2_EXTERNAL_EQ3_PATH/package/rpi-eeprom/Config.in"
  source "$BR2_EXTERNAL_EQ3_PATH/package/hardkernel-boot/Config.in"
endmenu

menu "Software Support"
  source "$BR2_EXTERNAL_EQ3_PATH/package/detect_radio_module/Config.in"
  source "$BR2_EXTERNAL_EQ3_PATH/package/daemonize/Config.in"
  source "$BR2_EXTERNAL_EQ3_PATH/package/ssdpd/Config.in"
  source "$BR2_EXTERNAL_EQ3_PATH/package/eq3configd/Config.in"
  source "$BR2_EXTERNAL_EQ3_PATH/package/wiringpi-rpi/Config.in"
  source "$BR2_EXTERNAL_EQ3_PATH/package/wiringpi-odroid/Config.in"
  source "$BR2_EXTERNAL_EQ3_PATH/package/neoserver/Config.in"
  source "$BR2_EXTERNAL_EQ3_PATH/package/qemu-guest-agent/Config.in"
  source "$BR2_EXTERNAL_EQ3_PATH/package/raspi-fanshim/Config.in"
  source "$BR2_EXTERNAL_EQ3_PATH/package/xe-guest-utilities/Config.in"
  source "$BR2_EXTERNAL_EQ3_PATH/package/tailscale-bin/Config.in"
endmenu

menu "Java Runtime Environment"
  source "$BR2_EXTERNAL_EQ3_PATH/package/java-azul/Config.in"
endmenu

# External packages
source "$BR2_EXTERNAL_EQ3_PATH/Config.ext.in"
```
